## sdkconfig.defaults
```kconfig
# Bootlader
CONFIG_BOOTLOADER_COMPILER_OPTIMIZATION_PERF=y
CONFIG_BOOTLOADER_LOG_LEVEL_NONE=y
CONFIG_BOOTLOADER_SKIP_VALIDATE_ON_POWER_ON=y

# System settings
CONFIG_ESPTOOLPY_FLASHSIZE_4MB=y

# Compiler settings
CONFIG_COMPILER_OPTIMIZATION_PERF=y
CONFIG_COMPILER_OPTIMIZATION_ASSERTIONS_DISABLE=y

# Application Level Tracing
CONFIG_APPTRACE_DEST_NONE=y
CONFIG_APPTRACE_SV_ENABLE=n

# Console settings
# CONFIG_ESP_CONSOLE_NONE=y #TODO cannot build when activated
CONFIG_ESP_CONSOLE_SECONDARY_NONE=y

# FreeRTOS settings
CONFIG_FREERTOS_ENABLE_BACKWARD_COMPATIBILITY=y
CONFIG_FREERTOS_HZ=1000

# Log settings
CONFIG_LOG_DEFAULT_LEVEL_NONE=y
CONFIG_LOG_MASTER_LEVEL=y
```

## sdkconfig.defaults.esp32h2
```kconfig
CONFIG_IDF_TARGET="esp32h2"

# FreeRTOS should use legacy API
CONFIG_FREERTOS_ENABLE_BACKWARD_COMPATIBILITY=y
```
